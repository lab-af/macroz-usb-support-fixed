## Kconfig
```kconfig
menuconfig MACROZ_DYNAMIC
    bool "MacroZ runtime keymap and macro support"
    default y
    depends on DT_HAS_MACROZ_BEHAVIOR_DYNAMIC_ENABLED
    select SETTINGS
    help
      Adds a dynamic key behavior, persistent macro storage, and a BLE
      configuration service for the MacroZ web configurator.

if MACROZ_DYNAMIC

config MACROZ_LOG_LEVEL
    int "MacroZ log level"
    range 0 4
    default 2

config MACROZ_USB
    bool "MacroZ USB serial (CDC ACM) configuration transport"
    default y
    select USB_CDC_ACM
    select USB_DEVICE_STACK
    select SERIAL
    select UART_INTERRUPT_DRIVEN
    select UART_LINE_CTRL
    help
      Adds a raw USB serial channel alongside the BLE configuration
      service, so the MacroZ web configurator can also connect over a
      wired USB connection using the Web Serial API.

endif
```

## boards/shields/labib_macropad/Kconfig.defconfig
```kconfig
if SHIELD_LABIB_MACROPAD

config ZMK_KEYBOARD_NAME
    default "Labib Macropad"

config ZMK_IDLE_SLEEP_TIMEOUT
    default 900000

endif
```

## boards/shields/labib_macropad/Kconfig.shield
```kconfig
config SHIELD_LABIB_MACROPAD
    def_bool $(shields_list_contains,labib_macropad)
```

## config/west.yml
```yaml
manifest:
  remotes:
    - name: zmkfirmware
      url-base: https://github.com/zmkfirmware
  projects:
    - name: zmk
      remote: zmkfirmware
      revision: 641514a97db345f499dd50b0360e594270f008fe
      import: app/west.yml
  self:
    path: config
```

## dts/bindings/behaviors/macroz,behavior-dynamic.yaml
```yaml
description: Runtime-configurable MacroZ key behavior
compatible: "macroz,behavior-dynamic"
include: one_param.yaml
```
